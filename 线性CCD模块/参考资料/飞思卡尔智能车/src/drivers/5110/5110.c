/******************** 唐野岐士 ********************
 * 描述         ：5110函数定义
 *
 *
**********************************************************************************/	
#include  "5110.h"

u8 Font_code[102][6] = {
{0x00,0x00,0x00,0x00,0x00,0x00},// (0)
{0x00,0x00,0x00,0x4F,0x00,0x00},//!(1)
{0x00,0x00,0x07,0x00,0x07,0x00},//"(2)
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{0x00,0x10,0x20,0x7F,0x20,0x10}//↓(130)
};

/*--------------------------------------------------------------*/
//写入一个字节(数据或指令)
//wbyte:	待写入的数据
//dat_cmd:	1-数据, 0-指令
void LCD_write_byte(u8 wbyte, u8 dat_cmd)
{
	u8 i;
  	LCD_CS_LOW();
  	if(dat_cmd) 
  	{
      	LCD_DC_HIGH();   
  	} 
  	else
  	{
      	LCD_DC_LOW();
  	}
//	LCD_DC = dat_cmd;	//1-数据	//0-指令
	for(i = 8; i; i--)	//8位数据, 先高后低
	{
		if(wbyte & 0x80) {LCD_DIN_HIGH();}
		else			 {LCD_DIN_LOW();}
		
		LCD_CLK_LOW();
		wbyte <<= 1;	//移位(延时)
		LCD_CLK_HIGH();	//上升沿写入
	}
	
	LCD_CS_HIGH();			//禁止
}

/*--------------------------------------------------------------*/
//显示清屏(清DDRAM)
void LCD_clr_scr(void)
{
	unsigned int i;
	
	LCD_write_cmd(X_Col_Addr);
	LCD_write_cmd(Y_Page_Addr);
	
	for(i = 504; i; i--) LCD_write_dat(0x00);
}
/*--------------------------------------------------------------*/
//液晶字节定位(1*1)
//液晶规划:
//x: 0 - 83
//y: 0 - 5
int LCD_pos_byte(int x, int y)
{
	x |= X_Col_Addr;  
	y |= Y_Page_Addr; 
	LCD_write_cmd(x);	//列地址
	LCD_write_cmd(y);	//页地址
	return 0;
}   

/*--------------------------------------------------------------*/
//显示清行
//num:	0 - 5
void LCD_clr_row(unsigned char num)
{
	unsigned char i;
	
	LCD_pos_byte(0, num);
	for(i = 84; i; i--) LCD_write_dat(0x00);
}
  
/*--------------------------------------------------------------*/
//液晶字母输出(6*8字体)
//x: 0 - 13
//y: 0 - 5
void LCD_printc(unsigned char x, unsigned char y, unsigned char c_dat)
{
	unsigned char i;
	c_dat -= 32;		//查表
	x *= 6;				//宽6
	LCD_pos_byte(x, y);	//坐标
	for(i = 0; i < 6; i++) LCD_write_dat(Font_code[c_dat][i]);	
}

/*--------------------------------------------------------------*/
//液晶数字输出(6*8字体)
//x: 0 - 13
//y: 0 - 5
void LCD_printc_my(unsigned char x, unsigned char y, unsigned char c_dat)
{
	unsigned char i;
	c_dat += 16;		//查表
	x *= 6;				//宽6
	LCD_pos_byte(x, y);	//坐标
	for(i = 0; i < 6; i++) LCD_write_dat(Font_code[c_dat][i]);	
}
/**************************************************************************
//液晶字符输出(6*8字体)显示一个8位整型数据
//x: 0 - 13
//y: 0 - 5
***************************************************************************/
void LCD_display_8int(unsigned char x, unsigned char y, unsigned char c_dat)
{
	unsigned char a,b,c;
	a = c_dat/100;
	b = c_dat%100/10;
	c = c_dat%10;
	LCD_printc_my(x , y ,  a);
	
	LCD_printc_my(x+1 , y ,  b);
	
	LCD_printc_my(x+2 , y ,  c);
	
}

/**************************************************************************
//液晶字符输出(6*8字体)显示一个16位整型数据
//x: 0 - 13
//y: 0 - 5
***************************************************************************/
void LCD_display_16int(unsigned char x, unsigned char y, unsigned int c_dat)
{
	unsigned char a,b,c,d,e;
	a = c_dat/10000;
	b = c_dat%10000/1000;
	c = c_dat%1000/100;
	d = c_dat%100/10;
	e = c_dat%10;

	LCD_printc_my(x , y ,  a);
	
	LCD_printc_my(x+1 , y ,  b);
	
	LCD_printc_my(x+2 , y ,  c);
	
	LCD_printc_my(x+3 , y ,  d);
	
	LCD_printc_my(x+4 , y ,  e);
		
}





/*--------------------------------------------------------------*/
//液晶字符串输出(6*8字体)
//x: 0 - 13
//y: 0 - 5
void LCD_prints(unsigned char x, unsigned char y, unsigned char *s_dat)
{
	while(*s_dat && x < 14) {LCD_printc(x++, y, *s_dat); s_dat++;}
}

/*--------------------------------------------------------------*/
//初始化LCD5110
void LCD5110_Init(void)
{
	
        gpio_init(PORTA,25,GPO,1);
        gpio_init(PORTA,26,GPO,1);
        gpio_init(PORTA,27,GPO,1);
        gpio_init(PORTA,28,GPO,1);
        
	LCD_reset_hard;				//硬件复位
	LCD_write_cmd(0x21);		//工作模式, 水平寻址, 扩展指令
//	LCD_write_cmd(0x06);		//VLCD温度系数2
///	LCD_write_cmd(0x13);		//设置偏置系统(BSx) 1:48
	LCD_write_cmd(0xcc);		//设置电压VLCD = 3.06 + 0.06*Vop, 对比度调整

	LCD_write_cmd(0x20);		//工作模式, 水平寻址, 常规指令
	LCD_write_cmd(0x0c);		//普通模式
	LCD_write_cmd(Y_Page_Addr);	//起始页地址0
	LCD_write_cmd(X_Col_Addr);	//起始列地址0
	LCD_clr_scr();				//清全屏
}
